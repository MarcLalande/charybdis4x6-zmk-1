## boards/shields/charybdis/Kconfig.defconfig
```kconfig
if SHIELD_CHARYBDIS_RIGHT

# Name must be less than 16 chars 
config ZMK_KEYBOARD_NAME
    default "Charybids 4x6"

config ZMK_SPLIT_ROLE_CENTRAL
    default y

endif

if SHIELD_CHARYBDIS_LEFT || SHIELD_CHARYBDIS_RIGHT

config ZMK_SPLIT
    default y

endif
```

## config/west.yml
```yaml
manifest:
  remotes:
    - name: zmkfirmware
      url-base: https://github.com/Amos698
      #url-base: https://github.com/zmkfirmware
  projects:
    - name: zmk
      remote: zmkfirmware
      #revision: main
      revision: feature-test
      import: app/west.yml
  self:
    path: config
```
